/* Copyright (c) 2017, The Linux Foundation. All rights reserved.
 * Copyright (C) 2019 XiaoMi, Inc.
 *
 * This program is free software; you can redistribute it and/or modify
 * it under the terms of the GNU General Public License version 2 and
 * only version 2 as published by the Free Software Foundation.
 *
 * This program is distributed in the hope that it will be useful,
 * but WITHOUT ANY WARRANTY; without even the implied warranty of
 * MERCHANTABILITY or FITNESS FOR A PARTICULAR PURPOSE.  See the
 * GNU General Public License for more details.
*/

&soc {
	goodix_fp {
		compatible = "goodix,fingerprint";
		interrupt-parent = <&tlmm>;
		interrupt = <72 0x0>;
		vcc_spi-supply = <&pm660l_l3>;
		vcc_ana-supply = <&pm660l_l3>;
		vdd_io-supply = <&pm660l_l3>;
		fp-gpio-irq = <&tlmm 72 0x00>;
		fp-gpio-reset = <&tlmm 20 0x00>;
		status = "okay";
	};

	fpc1020 {
		status = "ok";
		compatible = "fpc,fpc1020";
		interrupt-parent = <&tlmm>;
		interrupts = <72 0x0>;
		fpc,gpio_rst    = <&tlmm 20 0x0>;
		fpc,gpio_irq    = <&tlmm 72 0x0>;
		vcc_spi-supply  = <&pm660_l13>;
		vdd_io-supply   = <&pm660_l13>;
		vdd_ana-supply  = <&pm660_l13>;

		pinctrl-names = "fpc1020_reset_reset",
					"fpc1020_reset_active",
					"fpc1020_irq_active";

		pinctrl-0 = <&msm_gpio_20>;
		pinctrl-1 = <&msm_gpio_20_output_high>;
		pinctrl-2 = <&msm_gpio_72>;
		fpc,enable-on-boot;
		fpc,enable-wakeup;
	};
};
